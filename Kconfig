## Kconfig
```kconfig
config SPECTRA_ISP
	bool "enable camera ISP modele"
	help
	  This is enabling camera ISP module.
	  IFE camera driver file be included.
	  This will enable camera ISP driver to handle IFE driver.
	  Core camera driver to handle VFE HW.

config SPECTRA_ICP
	bool "enable camera ICP modele"
	help
	  This is enabling camera ICP module.
	  Camera ICP driver file be included.
	  This will enable camera ICP driver to interact with,
	  ICP FW. Which can control IPE and BPS HW.

config SPECTRA_JPEG
	bool "enable camera jpeg modele"
	help
	  This is enabling camera JPEG module.
	  camera jpeg module will be functional.
	  This module interact with jpeg HW for
	  snapshot processing.

config SPECTRA_SENSOR
	bool "enable camera sensor modele"
	help
	  This is enabling camera sensor module.
	  sensor module files will be included to enable the driver.
	  eeprom, flash, csiphy all other module will be included
	  to make the sensor functional.

config INTERCONNECT_QCOM
	bool "enabling icc bus driver"
	help
          This is to access icc driver api.
          To cache AB and IB vote will
          use ICC kernel driver API.
          So that ICC driver can consolidate the vote

config SPECTRA_FD
        bool "enabling camera fd modele"
        help
          This is enabling camera FD module.

config TZ_DCP_API_VER_2
	bool "enable secure camera DCP V2 Api"
	help
	  This is enabling secure camera. To use and enable
	  DCP version 2 api. This includes securemsm kernel
	  header files required to support DCP Version 2 API.
	  DCP Version 2 code only compile if this is enable.

config SECURE_CAMERA_25
	bool "enable secure camera 2.5"
	help
	  This config enables 2.5 secure camera
	  feature that allows the usage of non contiguous
	  buffers for the secure camera images by
	  lending the buffers to a trusted virtual machine.

config CAM_KTHREAD_WORKER
	bool "Enable kthread APIs in camera"
	help
	  This is enabling kernel thread modules to use
	  kthread APIs in camera.
	  When this flag is set, we support
	  kthread for camera kernel worker threads.

config MSM_GLOBAL_SYNX
	bool "enabling camera synxv1 module"
	help
	  This is enabling camera synx v1 module
	  that allows the usage of synx V1 APIs
	  and global synchronization across cores.
	  Synx V1 code only compiles if this is enabled.

config MSM_GLOBAL_SYNX_V2
	bool "enabling camera synxv2 module"
	help
	  This is enabling camera synx v2 module
	  that allows the usage of synx V2 APIs
	  and global synchronization across cores.
	  Synx V2 code only compiles if this is enabled.

config CAM_ENABLE_SOCCP
	bool "enabling soccp module"
	help
	  This is enabling SOCCP module.
	  Enabling this feature allows the usage of
	  HW fences. SOCCP HW related code only
	  compiles if this flag is enabled.
```

## niobe_gki_defconfig
```kconfig
CONFIG_SPECTRA_ISP=y
CONFIG_SPECTRA_ICP=y
CONFIG_SPECTRA_JPEG=y
CONFIG_SPECTRA_SENSOR=y
CONFIG_SPECTRA_FD=y
CONFIG_INTERCONNECT_QCOM=y
CONFIG_TZ_DCP_API_VER_2=y
CONFIG_SECURE_CAMERA_25=y
CONFIG_CAM_KTHREAD_WORKER=y
CONFIG_MSM_GLOBAL_SYNX_V2=y
CONFIG_CAM_ENABLE_SOCCP=y
```
